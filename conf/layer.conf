## conf/layer.conf
```bitbake
# We have a conf and classes directory, append to BBPATH
BBPATH .= ":${LAYERDIR}"

# We have a recipes directory, add to BBFILES
BBFILES += "${LAYERDIR}/recipes-*/*/*.bb ${LAYERDIR}/recipes-*/*/*.bbappend"

BBFILE_COLLECTIONS += "meta-iot-cloud-test"
BBFILE_PATTERN_meta-iot-cloud-test := "^${LAYERDIR}/"
BBFILE_PRIORITY_meta-iot-cloud-test = "7"
LAYERSERIES_COMPAT_meta-iot-cloud-test = "sumo"
```
